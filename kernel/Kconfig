## kernel/Kconfig
```kconfig
menu "KernelSU"

config KSU
	tristate "KernelSU function support"
	depends on KPROBES && EXT4_FS
	default y
	help
	  Enable kernel-level root privileges on Android System.
	  Requires CONFIG_KPROBES for kernel hooking support.
	  Requires CONFIG_EXT4_FS for `ext4_unregister_sysfs`.
	  To compile as a module, choose M here: the
	  module will be called kernelsu.

config KSU_DEBUG
	bool "KernelSU debug mode"
	depends on KSU
	default n
	help
	  Enable KernelSU debug mode.

config KSU_DISABLE_MANAGER
	bool "Disable KernelSU manager integration"
	depends on KSU
	default n
	help
	  Disable manager APK detection and manager-specific handling.
	  Root will be used in place of manager-only functionality.

config KSU_KPM
	bool "Enable KPM (KernelPatch Module) bridge"
	depends on KSU
	default y
	help
	  Compile in the KernelPatch supercall bridge used by KPM modules.
	  Loading KPM modules still requires the running kernel image to be
	  patched with KernelPatch (kpimg); without it every KPM operation
	  returns -EOPNOTSUPP.

config KSU_DISABLE_POLICY
	bool "Disable KernelSU policy profiles"
	depends on KSU
	default n
	help
	  Disable per-app root/non-root profile customization.
	  Escalation will always use the default full root profile, and
	  non-root handling will follow the global umount policy only.

config KSU_DISABLE_BUILTIN_MANAGER_SIGNATURES
	bool "Disable built-in third-party manager signatures"
	depends on KSU && !KSU_DISABLE_MANAGER
	default n
	help
	  KernelSU-family managers from other projects (KernelSU official,
	  SukiSU, BakaSU, KOWX712, ...) are trusted in addition to WoouSU's own
	  manager when their signing certificate matches the built-in list.
	  Enable this to trust only WoouSU's manager plus the dynamic manager
	  signature selected at runtime.

config KSU_STEALTH
	bool "Stealth mode (suppress kernel-visible branding and boot logs)"
	depends on KSU
	default y
	help
	  Compile out KernelSU-branded log prefixes and boot-time banners,
	  and make kernel log output look like an ordinary WLAN driver.
	  Recommended for WoouSU builds.

config KSU_X86_PATCH_SYSCALL_DISPATCHER
	bool "Dynamically patch x64's hardened syscall dispatcher to support syscall hooks"
	depends on KSU && X86_64
	default n
	help
	  Dynamically patch x64's hardened syscall dispatcher to support syscall hooks. This is a
	  replacement for a kernel source code patch, and is useful for x86_64 LKM mode.

endmenu
```
